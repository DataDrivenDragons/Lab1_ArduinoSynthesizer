#define SAMPLES_A4 90
#define SAMPLES_E4 121
const PROGMEM byte a4[91] = {256,255,254,253,250,248,244,240,236,231,225,219,212,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255,256};
const PROGMEM byte e4[122] = {256,255,255,254,253,251,249,247,244,242,238,235,231,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255,256};
int len = floor(3000/SAMPLES_E4);
int len2 = floor(3000/SAMPLES_A4);
void setup(){
  DDRD = B11111111;
  PORTD = B00000000;
//  Serial.begin(9600);
}

void loop(){
//  Serial.println("Begin Song");
    for (int j=0; j<len; j++){
      for (int i=0; i<SAMPLES_E4; i++) {
        PORTD = e4[i];
        delayMicroseconds(50);
      }
    }
     for (int n=0; n<3001; n++){
        PORTD=B00000000;
        delayMicroseconds(50);
    }
     for (int m=0; m<len2; m++){
      for (int k=0; k<SAMPLES_A4; k++) {
        PORTD = a4[k];
        delayMicroseconds(50);
      }
    }
//    delay(100);
//    for (int k=0; k<SAMPLES; k++) {
////        Serial.println(C5[i]);
//      PORTD = C5[k];
//      delayMicroseconds(50);

//    }
}

